## boards/qemu/arm64/virt/configs/darkos_qemu_arm64_defconfig
```kconfig
CONFIG_LOCALVERSION="-darkos-qemu"
# CONFIG_LOCALVERSION_AUTO is not set
CONFIG_SYSVIPC=y
CONFIG_POSIX_TIMERS=y
CONFIG_BLK_DEV_INITRD=y
CONFIG_RD_GZIP=y
CONFIG_EXPERT=y
# CONFIG_MODULES is not set
CONFIG_BINFMT_ELF=y
CONFIG_BINFMT_SCRIPT=y
CONFIG_NET=y
CONFIG_PACKET=y
CONFIG_UNIX=y
CONFIG_INET=y
CONFIG_DEVTMPFS=y
CONFIG_DEVTMPFS_MOUNT=y
CONFIG_NETDEVICES=y
# CONFIG_WLAN is not set
# CONFIG_WIRELESS is not set
# CONFIG_INPUT is not set
# CONFIG_VT is not set
CONFIG_TTY=y
CONFIG_PROC_FS=y
CONFIG_SYSFS=y
CONFIG_TMPFS=y
CONFIG_TMPFS_POSIX_ACL=y
# CONFIG_DEBUG_KERNEL is not set
# CONFIG_DEBUG_INFO is not set
# CONFIG_FTRACE is not set
# CONFIG_SOUND is not set
# CONFIG_DRM is not set
# CONFIG_USB_SUPPORT is not set
```

## boards/qemu/arm64/virt/configs/darkos_qemu_arm64_uboot_defconfig
```kconfig
CONFIG_ARM=y
CONFIG_ARCH_QEMU=y
CONFIG_SYS_MALLOC_LEN=0x1000000
CONFIG_CUSTOM_SYS_INIT_SP_ADDR=0x40200000
CONFIG_DEFAULT_DEVICE_TREE="qemu-arm64"
CONFIG_SYS_LOAD_ADDR=0x42000000
CONFIG_RELOC_ADDR_TOP=y
CONFIG_FIT=y
CONFIG_LEGACY_IMAGE_FORMAT=y
CONFIG_SUPPORT_RAW_INITRD=y
CONFIG_BOOTDELAY=1
CONFIG_USE_BOOTCOMMAND=y
CONFIG_BOOTCOMMAND="source 0x41000000"
CONFIG_CMD_BOOTI=y
CONFIG_CMD_SOURCE=y
CONFIG_ENV_IS_NOWHERE=y
# CONFIG_ENV_IS_IN_FLASH is not set
# CONFIG_DISPLAY_CPUINFO is not set
# CONFIG_DISPLAY_BOARDINFO is not set
# CONFIG_BOARD_INIT is not set
# CONFIG_BOOTSTD is not set
# CONFIG_EFI_LOADER is not set
# CONFIG_VIDEO is not set
# CONFIG_USB is not set
# CONFIG_PCI is not set
# CONFIG_NET is not set
# CONFIG_MMC is not set
# CONFIG_MTD is not set
# CONFIG_UNIT_TEST is not set
CONFIG_SYSRESET=y
CONFIG_SYSRESET_CMD_POWEROFF=y
CONFIG_SYSRESET_PSCI=y
```

## boards/qemu/arm64/virt/configs/qemu_arm64_virt_defconfig
```kconfig
BR2_aarch64=y
BR2_PRIMARY_SITE="https://sources.buildroot.net"
BR2_TOOLCHAIN_EXTERNAL=y
BR2_TOOLCHAIN_EXTERNAL_CUSTOM=y
BR2_TOOLCHAIN_EXTERNAL_PREINSTALLED=y
BR2_TOOLCHAIN_EXTERNAL_GCC_8=y
BR2_TOOLCHAIN_EXTERNAL_HEADERS_4_19=y
BR2_TOOLCHAIN_EXTERNAL_CUSTOM_GLIBC=y
BR2_TOOLCHAIN_EXTERNAL_HAS_SSP=y
BR2_TARGET_GENERIC_HOSTNAME="darkos-qemu"
BR2_TARGET_GENERIC_ISSUE="DarkOS QEMU ARM64"
BR2_TARGET_GENERIC_GETTY_PORT="ttyAMA0"
BR2_SYSTEM_DHCP="eth0"
BR2_PACKAGE_DARKOS_BSP_INFO=y
BR2_TARGET_ROOTFS_CPIO=y
BR2_TARGET_ROOTFS_CPIO_GZIP=y
# BR2_TARGET_ROOTFS_TAR is not set
# BR2_LINUX_KERNEL is not set
# BR2_TARGET_UBOOT is not set
```

## boards/rockchip/rk3588s/lubancat-4/configs/darkos_lubancat_4_defconfig
```kconfig
BR2_aarch64=y
BR2_cortex_a76_a55=y
BR2_PRIMARY_SITE="https://sources.buildroot.net"
BR2_TOOLCHAIN_EXTERNAL=y
BR2_TOOLCHAIN_EXTERNAL_CUSTOM=y
BR2_TOOLCHAIN_EXTERNAL_PREINSTALLED=y
# GCC/headers/path/prefix 会由 BSP_ROOTFS_EXTERNAL_AUTO 按实际工具链生成。
BR2_TOOLCHAIN_EXTERNAL_GCC_13=y
BR2_TOOLCHAIN_EXTERNAL_HEADERS_6_1=y
BR2_TOOLCHAIN_EXTERNAL_CUSTOM_GLIBC=y
BR2_TOOLCHAIN_EXTERNAL_HAS_SSP=y
# BR2_TOOLCHAIN_EXTERNAL_INET_RPC is not set
BR2_TARGET_GENERIC_HOSTNAME="darkos-lubancat4"
BR2_TARGET_GENERIC_ISSUE="DarkOS LubanCat-4 development system"
BR2_TARGET_GENERIC_GETTY_PORT="ttyS2"
# 保留内核 console=ttyS2,1500000n8 的速率，Buildroot 无 1500000 选项。
BR2_TARGET_GENERIC_GETTY_BAUDRATE_KEEP=y
BR2_ROOTFS_DEVICE_CREATION_DYNAMIC_MDEV=y
BR2_SYSTEM_DHCP="eth0"
BR2_PACKAGE_DARKOS_BSP_INFO=y
BR2_TARGET_ROOTFS_EXT2=y
BR2_TARGET_ROOTFS_EXT2_4=y
BR2_TARGET_ROOTFS_EXT2_LABEL="rootfs"
BR2_TARGET_ROOTFS_EXT2_SIZE="256M"
# BR2_TARGET_ROOTFS_TAR is not set
# BR2_LINUX_KERNEL is not set
# BR2_TARGET_UBOOT is not set
```

## boards/visinex/v816/zs_evb1/configs/zs_evb1_defconfig
```kconfig
# zs_evb1 的内核 defconfig：最小 ARM64 用户态启动基座，硬件驱动由四层片段补齐。
# 使用方法：复制改名为 zs_evb1_defconfig；无板级特有配置时可删除 bsp.mk 中
# BSP_DEFCONFIG 两行，沿用芯片层默认值。
CONFIG_LOCALVERSION="-darkos-zs_evb1"
# CONFIG_LOCALVERSION_AUTO is not set
CONFIG_SYSVIPC=y
CONFIG_POSIX_TIMERS=y
CONFIG_HIGH_RES_TIMERS=y
CONFIG_PREEMPT_NONE=y
CONFIG_EXPERT=y
CONFIG_FHANDLE=y
CONFIG_BINFMT_ELF=y
CONFIG_BINFMT_SCRIPT=y
CONFIG_FUTEX=y
CONFIG_EPOLL=y
CONFIG_SHMEM=y
CONFIG_BLOCK=y
CONFIG_SMP=y
# CONFIG_MODULES is not set
CONFIG_NET=y
CONFIG_PACKET=y
CONFIG_UNIX=y
CONFIG_INET=y
CONFIG_DEVTMPFS=y
CONFIG_DEVTMPFS_MOUNT=y
CONFIG_PARTITION_ADVANCED=y
CONFIG_EFI_PARTITION=y
CONFIG_TTY=y
CONFIG_SERIAL_8250=y
CONFIG_SERIAL_8250_CONSOLE=y
CONFIG_SERIAL_8250_DW=y
CONFIG_SERIAL_OF_PLATFORM=y
CONFIG_PROC_FS=y
CONFIG_SYSFS=y
CONFIG_TMPFS=y
CONFIG_EXT4_FS=y
# CONFIG_DEBUG_INFO is not set
# CONFIG_DEBUG_KERNEL is not set
```

## boards/visinex/v816/zs_hm2/configs/darkos_zs_hm2_defconfig
```kconfig
# zs_hm2 的 Buildroot defconfig；GCC/headers/路径/前缀各会由 BSP_ROOTFS_EXTERNAL_AUTO
# 按实际工具链自动改写，无需手工维护。使用方法：复制改名为 darkos_zs_hm2_defconfig。
BR2_aarch64=y
# CPU 核型号按芯片替换（如 rk3588s 为 cortex_a76_a55）。
BR2_cortex_a76_a55=y
BR2_PRIMARY_SITE="https://sources.buildroot.net"
BR2_TOOLCHAIN_EXTERNAL=y
BR2_TOOLCHAIN_EXTERNAL_CUSTOM=y
BR2_TOOLCHAIN_EXTERNAL_PREINSTALLED=y
BR2_TOOLCHAIN_EXTERNAL_GCC_13=y
BR2_TOOLCHAIN_EXTERNAL_HEADERS_6_1=y
BR2_TOOLCHAIN_EXTERNAL_CUSTOM_GLIBC=y
BR2_TOOLCHAIN_EXTERNAL_HAS_SSP=y
# BR2_TOOLCHAIN_EXTERNAL_INET_RPC is not set
BR2_TARGET_GENERIC_HOSTNAME="darkos-zs_hm2"
BR2_TARGET_GENERIC_ISSUE="DarkOS zs_hm2 development system"
# 调试串口按板卡实际修改；速率非标准值时保留 BAUDRATE_KEEP 并在内核命令行指定。
BR2_TARGET_GENERIC_GETTY_PORT="ttyS0"
BR2_TARGET_GENERIC_GETTY_BAUDRATE_KEEP=y
BR2_ROOTFS_DEVICE_CREATION_DYNAMIC_MDEV=y
BR2_SYSTEM_DHCP="eth0"
BR2_PACKAGE_DARKOS_BSP_INFO=y
BR2_TARGET_ROOTFS_EXT2=y
BR2_TARGET_ROOTFS_EXT2_4=y
BR2_TARGET_ROOTFS_EXT2_LABEL="rootfs"
BR2_TARGET_ROOTFS_EXT2_SIZE="256M"
# BR2_TARGET_ROOTFS_TAR is not set
# 内核和 U-Boot 由 BSP 脚本单独构建，这里不重复编。
# BR2_LINUX_KERNEL is not set
# BR2_TARGET_UBOOT is not set
```

## common/packages/Config.in
```kconfig
menu "DarkOS packages"
source "$BR2_EXTERNAL_DARKOS_PATH/layers/common/packages/darkos-bsp-info/Config.in"
source "$BR2_EXTERNAL_DARKOS_PATH/layers/common/packages/optee-local/Config.in"
endmenu
```

## common/packages/darkos-bsp-info/Config.in
```kconfig
config BR2_PACKAGE_DARKOS_BSP_INFO
	bool "darkos-bsp-info"
	help
	  Install the darkos-info command and selected BSP target information.
```

## generic/packages/Config.in
```kconfig
menu "DarkOS packages"
source "$BR2_EXTERNAL_DARKOS_PATH/layers/generic/packages/darkos-bsp-info/Config.in"
source "$BR2_EXTERNAL_DARKOS_PATH/layers/generic/packages/optee-local/Config.in"
endmenu
```

## generic/packages/optee-local/Config.in
```kconfig
config BR2_PACKAGE_DARKOS_OPTEE_CLIENT_SERVICE
	bool "OP-TEE supplicant device-aware startup"
	depends on BR2_PACKAGE_OPTEE_CLIENT
	depends on BR2_INIT_BUSYBOX || BR2_INIT_SYSV
	default y
	help
	  Use the native Buildroot optee-client package and replace its
	  SysV startup script with a device-aware script. It starts
	  tee-supplicant only when /dev/teepriv0 is present.

	  The OP-TEE trusted OS, secure monitor and device tree must
	  already be configured by the platform firmware. This option
	  does not load OP-TEE or enable secure boot.
```

## vendors/rockchip/rk3588s/configs/rk3588s_defconfig
```kconfig
# 最小 ARM64 用户态启动基础；硬件驱动由厂商/SoC/板级片段补齐。
CONFIG_LOCALVERSION="-darkos"
# CONFIG_LOCALVERSION_AUTO is not set
CONFIG_SYSVIPC=y
CONFIG_POSIX_TIMERS=y
CONFIG_HIGH_RES_TIMERS=y
CONFIG_PREEMPT_NONE=y
CONFIG_EXPERT=y
CONFIG_FHANDLE=y
CONFIG_BINFMT_ELF=y
CONFIG_BINFMT_SCRIPT=y
CONFIG_FUTEX=y
CONFIG_EPOLL=y
CONFIG_SHMEM=y
CONFIG_BLOCK=y
CONFIG_SMP=y
# CONFIG_MODULES is not set
CONFIG_NET=y
CONFIG_PACKET=y
CONFIG_UNIX=y
CONFIG_INET=y
CONFIG_DEVTMPFS=y
CONFIG_DEVTMPFS_MOUNT=y
CONFIG_PARTITION_ADVANCED=y
CONFIG_EFI_PARTITION=y
CONFIG_TTY=y
CONFIG_SERIAL_8250=y
CONFIG_SERIAL_8250_CONSOLE=y
CONFIG_SERIAL_8250_DW=y
CONFIG_SERIAL_OF_PLATFORM=y
CONFIG_PROC_FS=y
CONFIG_SYSFS=y
CONFIG_TMPFS=y
CONFIG_EXT4_FS=y
# CONFIG_DEBUG_INFO is not set
# CONFIG_DEBUG_KERNEL is not set
```
